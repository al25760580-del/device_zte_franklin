/dts-v1/;

/ {

	fragment@0 {
		target-path = "/";

		__overlay__ {

			dummy-battery {
				compatible = "amlogic, dummy-battery";
				status = "okay";
			};
		};
	};

	fragment@1 {
		target-path = "/";

		__overlay__ {

			dummy-charger {
				compatible = "amlogic, dummy-charger";
				status = "okay";
			};
		};
	};
};
